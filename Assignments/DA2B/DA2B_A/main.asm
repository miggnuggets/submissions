;
; DA2B_A.asm
;
; Created: 3/8/2019 11:02:52 PM
; Author : Migggy
;
.ORG 0
	JMP MAIN
.ORG 0X02 ; LOCATION FOR EXTERNAL INTERRUPT 0
	JMP EX0_ISR	
MAIN: 
	LDI R22, HIGH(RAMEND)
	OUT SPH, R22
	LDI R22, LOW(RAMEND)
	OUT SPL, R22 ; INITIALIZE STACK
	LDI R22, 0X02 ; MAKE INT0 FALLING EDGE TRIGGERED 
	STS	EICRA, R22 ; EXTERNAL INTERRUPT CONTROL REG AIS SET
	SBI DDRB, 2 ; PORTB.2 AS OUTPUT
	CBI	PORTB, 2
	SBI PORTD, 2 ; PULL UP
	LDI R22, 1<<INT0 ; ENABLE INT0 
	OUT EIMSK, R22 ; EXTERNAL INTERRUPT MASK
	SEI 	; ENABLE INTERRUPTS
HERE: JMP HERE
EX0_ISR:
	SBI		PORTB, 2
	RCALL	Timer
	CBI		PORTB, 2	
	RETI
Timer:
	   LDI R19, 100
Loop0: LDI R20, 200
Loop1: LDI R21, 200
Loop2:  NOP
	NOP
	DEC R21
	BRNE Loop2
	DEC R20
	BRNE Loop1
	DEC R19
	BRNE Loop0
	RET
